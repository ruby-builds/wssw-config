## config/boards/shields/wssw/Kconfig.defconfig
```kconfig
# Copyright (c) 2020 The ZMK Contributors
# SPDX-License-Identifier: MIT

# config ZMK_BLE
#	default y

#config ZMK_USB
#	default y

if SHIELD_WSSW_LEFT || SHIELD_WSSW_RIGHT

config ZMK_KEYBOARD_NAME
	default "WSSW"

endif

if SHIELD_WSSW_RIGHT

config ZMK_SPLIT
	default y

endif



if SHIELD_WSSW_LEFT

config ZMK_SPLIT
	default y



endif

if SHIELD_WSSW_DONGLE

config ZMK_KEYBOARD_NAME
	default "WSSW Dongle"

config ZMK_SPLIT
	default y

config ZMK_SPLIT_BLE_ROLE_CENTRAL
	default y

endif
```

## config/boards/shields/wssw/Kconfig.shield
```kconfig
# Copyright (c) 2020 The ZMK Contributors
# SPDX-License-Identifier: MIT

config SHIELD_WSSW_LEFT
	def_bool $(shields_list_contains,wssw_left)

config SHIELD_WSSW_RIGHT
	def_bool $(shields_list_contains,wssw_right)

config SHIELD_WSSW_DONGLE
	def_bool $(shields_list_contains,wssw_dongle)
```
